## main/Kconfig.projbuild
```kconfig
menu "esp32-freqcount Configuration"

config ONBOARD_LED_GPIO
    int "Onboard LED GPIO number"
    range 0 34
    default 2
    help
        GPIO number (IOxx) connected to onboard LED.

config FREQ_SIGNAL_GPIO
    int "Frequency signal GPIO number"
	range 0 34
	default 4
	help
		GPIO number (IOxx) from which to read frequency signal.

		Some GPIOs are used for other purposes (flash connections, etc.) and cannot be used.

		GPIOs 35-39 are input-only so cannot be used to drive the One Wire Bus.

endmenu
```
